## config/west.yml
```yaml
manifest:
  remotes:
    - name: gavinliu0
      url-base: https://github.com/gavinliu0
  projects:
    - name: zmk
      remote: gavinliu0
      revision: default_rebound
      import: app/west.yml
  self:
    path: config
```
